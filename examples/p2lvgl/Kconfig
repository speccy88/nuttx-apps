## testing/p2bringup/Kconfig
```kconfig
#
# For a description of the syntax of this configuration file,
# see the file kconfig-language.txt in the NuttX tools repository.
#

config TESTING_P2BRINGUP
	tristate "Propeller 2 deterministic kernel bring-up"
	default n
	depends on ARCH_P2 && BUILD_FLAT
	depends on ARCH_HAVE_STACKCHECK && STACK_COLORATION
	depends on SCHED_HAVE_PARENT && SCHED_CHILD_STATUS && SCHED_WAITPID
	---help---
		Enable a direct-init Propeller 2 kernel test.  It verifies initialized
		and zeroed storage, Hub heap bounds, timer wake-up, task exit and
		recreation, semaphore-driven priority preemption, upward PTRA bounds,
		and stack coloration.  Each successful stage emits a deterministic
		P2NUTTX marker for hardware automation.

if TESTING_P2BRINGUP

config TESTING_P2BRINGUP_PROGNAME
	string "Program name"
	default "p2bringup"

config TESTING_P2BRINGUP_PRIORITY
	int "Worker priority"
	default 110
	range 1 255

config TESTING_P2BRINGUP_STACKSIZE
	int "Worker stack size"
	default 2048

config TESTING_P2BRINGUP_SLEEP_MSEC
	int "Timer wake-up interval in milliseconds"
	default 100
	range 10 1000

endif
```

## testing/p2clock/Kconfig
```kconfig
#
# For a description of the syntax of this configuration file,
# see the file kconfig-language.txt in the NuttX tools repository.
#

config TESTING_P2CLOCK
	tristate "Propeller 2 raw-counter calibration endpoint"
	default n
	depends on ARCH_P2 && BUILD_FLAT && UART0_SERIAL_CONSOLE
	---help---
		Enable a direct-init endpoint that captures raw GETCT values only in
		response to framed host requests.  Independent host monotonic time,
		not the target scheduler tick, qualifies clock frequency and drift.

if TESTING_P2CLOCK

config TESTING_P2CLOCK_PROGNAME
	string "Program name"
	default "p2clock"

endif
```

## testing/p2i2c/Kconfig
```kconfig
#
# For a description of the syntax of this configuration file,
# see the file kconfig-language.txt in the NuttX tools repository.
#

config TESTING_P2I2C
	tristate "Propeller 2 BMP180 I2C HIL test"
	default n
	depends on ARCH_P2 && BUILD_FLAT
	depends on I2C && I2C_DRIVER
	depends on SENSORS_BMP180 && !SENSORS_BMP180_UORB
	---help---
		Enable the direct-init Propeller 2 BMP180 test.  It proves a raw
		repeated-start register read through /dev/i2c0, then obtains exactly
		32 plausible pressure readings from the legacy /dev/press0 interface.

if TESTING_P2I2C

config TESTING_P2I2C_PROGNAME
	string "Program name"
	default "p2i2c"

endif
```

## testing/p2psram/Kconfig
```kconfig
#
# For a description of the syntax of this configuration file,
# see the file kconfig-language.txt in the NuttX tools repository.
#

config TESTING_P2PSRAM
	tristate "Propeller 2 external PSRAM service HIL test"
	default n
	depends on ARCH_P2 && BUILD_FLAT
	depends on P2_EC32MB_PSRAM
	depends on P2_EC32MB_PSRAM_FAULT_INJECT_TIMEOUT
	depends on BUILTIN && NSH_BUILTIN_APPS
	---help---
		Enable a bounded, destructive test of the explicit /dev/psram0
		service.  External PSRAM remains a character-device bulk store; this
		test never treats it as native heap, stack, code, or pointer memory.
		The board's one-request cooperative-stall hook makes the timeout proof
		deterministic without depending on the selected PSRAM wire clock.

if TESTING_P2PSRAM

config TESTING_P2PSRAM_PROGNAME
	string "Program name"
	default "p2psram"

config TESTING_P2PSRAM_STACKSIZE
	int "Main task stack size"
	default 4096
	range 3072 8192

config TESTING_P2PSRAM_WORKER_STACKSIZE
	int "Concurrent workload stack size"
	default 2048
	range 1536 4096

config TESTING_P2PSRAM_RANDOM_COUNT
	int "Random unaligned transfer count"
	default 1024
	range 256 4096

endif
```

## testing/p2schedstress/Kconfig
```kconfig
#
# For a description of the syntax of this configuration file,
# see the file kconfig-language.txt in the NuttX tools repository.
#

config TESTING_P2SCHEDSTRESS
	tristate "Propeller 2 scheduler and context stress"
	default n
	depends on ARCH_P2 && BUILD_FLAT
	depends on !DISABLE_PTHREAD && !DISABLE_MQUEUE
	depends on !DISABLE_POSIX_TIMERS && ENABLE_ALL_SIGNALS
	depends on CANCELLATION_POINTS && PRIORITY_INHERITANCE
	depends on ARCH_HAVE_STACKCHECK && STACK_COLORATION && STACK_USAGE
	depends on SCHED_HAVE_PARENT && SCHED_CHILD_STATUS && SCHED_WAITPID
	depends on RR_INTERVAL > 0
	---help---
		Enable a direct-init Propeller 2 flat-UP stress target.  Successful
		runs account for 1,004,078 real scheduling and synchronization
		events across priority preemption, round-robin baton transfers,
		semaphores, priority-inheritance mutexes, condition variables,
		POSIX message queues, signals, POSIX timers, pthread lifecycle, and
		task recreation.  Heap and colored-stack checks are reported
		separately, including 512 two-thread concurrent allocation rounds.
		The terminal P2SCHED:PASS marker is emitted only after every category
		reaches its exact target.

if TESTING_P2SCHEDSTRESS

config TESTING_P2SCHEDSTRESS_PROGNAME
	string "Program name"
	default "p2schedstress"

config TESTING_P2SCHEDSTRESS_PRIORITY
	int "High worker priority"
	default 120
	range 2 254

config TESTING_P2SCHEDSTRESS_STACKSIZE
	int "Pthread stack size"
	default 3072
	range 2048 8192

config TESTING_P2SCHEDSTRESS_TASK_STACKSIZE
	int "Recreated task stack size"
	default 2048
	range 1536 8192

endif
```

## testing/p2smartpins/Kconfig
```kconfig
#
# For a description of the syntax of this configuration file,
# see the file kconfig-language.txt in the NuttX tools repository.
#

config TESTING_P2SMARTPINS
	tristate "Propeller 2 deterministic Smart Pin HIL test"
	default n
	depends on ARCH_P2 && BUILD_FLAT
	depends on P2_EC32MB_GPIO && DEV_GPIO
	---help---
		Enable the deterministic Propeller 2 Smart Pin loopback test.  The
		baseline drives P0 while sampling P1 through /dev/gpio0 and
		/dev/gpio1.  The receiver is always configured before the source, and
		both endpoints are returned to floating inputs on exit.

if TESTING_P2SMARTPINS

config TESTING_P2SMARTPINS_PROGNAME
	string "Program name"
	default "p2smartpins"

config TESTING_P2SMARTPINS_GPIO_OUT_DEVPATH
	string "P0 GPIO output device"
	default "/dev/gpio0"

config TESTING_P2SMARTPINS_GPIO_IN_DEVPATH
	string "P1 GPIO input device"
	default "/dev/gpio1"

config TESTING_P2SMARTPINS_EDGE
	bool "Test P0 to P1 GPIO edge notifications"
	default n
	depends on DEV_GPIO_NSIGNALS > 0
	---help---
		Require GPIO_INTERRUPT_BOTH_PIN and GPIOC_REGISTER support on P1.
		P1 is armed before P0 is driven.  Do not select this option until the
		P2 Smart Pin event is connected to a real architecture interrupt.

config TESTING_P2SMARTPINS_UART
	bool "Test configurable UART on P2 to P3"
	default n
	depends on SERIAL_TERMIOS
	---help---
		Send and receive a deterministic 16-byte record through a non-console
		UART.  The lower half must configure P3 as an input before enabling
		P2 as an output.

config TESTING_P2SMARTPINS_UART_DEVPATH
	string "Configurable UART device"
	default "/dev/ttyS1"
	depends on TESTING_P2SMARTPINS_UART

config TESTING_P2SMARTPINS_PWM_CAPTURE
	bool "Test P4 PWM to P5 capture"
	default n
	depends on PWM && CAPTURE
	---help---
		Measure 1-kHz PWM at 25, 50, and 75 percent duty through the standard
		PWM and capture upper halves.  The capture device is opened before the
		PWM source is enabled.

config TESTING_P2SMARTPINS_PWM_DEVPATH
	string "P4 PWM device"
	default "/dev/pwm0"
	depends on TESTING_P2SMARTPINS_PWM_CAPTURE

config TESTING_P2SMARTPINS_CAPTURE_DEVPATH
	string "P5 capture device"
	default "/dev/cap0"
	depends on TESTING_P2SMARTPINS_PWM_CAPTURE

config TESTING_P2SMARTPINS_DAC_ADC
	bool "Test P4 DAC to P5 ADC"
	default n
	depends on DAC && ADC
	---help---
		Verify three monotonically increasing DAC/ADC samples.  This option
		must remain disabled for a direct short: install and verify the
		appropriate analog series resistance first.  The ADC is opened before
		the DAC source is enabled.

config TESTING_P2SMARTPINS_DAC_DEVPATH
	string "P4 DAC device"
	default "/dev/dac0"
	depends on TESTING_P2SMARTPINS_DAC_ADC

config TESTING_P2SMARTPINS_ADC_DEVPATH
	string "P5 ADC device"
	default "/dev/adc0"
	depends on TESTING_P2SMARTPINS_DAC_ADC

config TESTING_P2SMARTPINS_DAC_FULL_SCALE
	int "DAC full-scale code"
	default 65535
	range 255 2147483647
	depends on TESTING_P2SMARTPINS_DAC_ADC

config TESTING_P2SMARTPINS_SPI
	bool "Test P6 SPI MOSI to P7 MISO"
	default n
	depends on P2_EC32MB_SPI && SPI_DRIVER && SPI_EXCHANGE
	---help---
		Exchange a deterministic 16-byte record through the standard SPI test
		character driver.  P7 must be configured as MISO before P6 is enabled
		as MOSI.  P8 clock and P9 chip select are deliberately unconnected
		controller outputs and are not part of the P6-P7 link.

config TESTING_P2SMARTPINS_SPI_DEVPATH
	string "General-purpose SPI character device"
	default "/dev/spi0"
	depends on TESTING_P2SMARTPINS_SPI

endif
```

## testing/p2storage/Kconfig
```kconfig
#
# For a description of the syntax of this configuration file,
# see the file kconfig-language.txt in the NuttX tools repository.
#

config TESTING_P2STORAGE
	tristate "Propeller 2 deterministic storage HIL test"
	default n
	depends on ARCH_P2 && BUILD_FLAT
	depends on P2_EC32MB_STORAGE_BINDINGS
	depends on MTD_SMART && FS_SMARTFS
	depends on MMCSD_SPI && FS_FAT
	depends on !DISABLE_MOUNTPOINT
	---help---
		Enable a command-driven test for the protected onboard SMART flash
		partition and the removable microSD block device.  The probe and
		persistence-verification commands are read-only.  No command runs at
		boot and formatting is never automatic.

if TESTING_P2STORAGE

config TESTING_P2STORAGE_PROGNAME
	string "Program name"
	default "p2storage"

config TESTING_P2STORAGE_STACKSIZE
	int "Task stack size"
	default 4096
	range 2048 16384

config TESTING_P2STORAGE_FLASH_DEVPATH
	string "Protected SMART flash block device"
	default "/dev/smart0"

config TESTING_P2STORAGE_FLASH_MOUNTPOINT
	string "SMART flash mount point"
	default "/mnt/flash"

config TESTING_P2STORAGE_SD_DEVPATH
	string "microSD block device"
	default "/dev/mmcsd0"

config TESTING_P2STORAGE_SD_MOUNTPOINT
	string "microSD mount point"
	default "/mnt/sd"

config TESTING_P2STORAGE_RECORD_SIZE
	int "Deterministic persistence record size"
	default 256
	range 256 256
	---help---
		The strict host protocol and target use one byte-defined 256-byte
		record.  The fixed range prevents the built image from silently
			drifting away from host-side checksum expectations.

config TESTING_P2STORAGE_STREAM_SIZE
	int "Persistent streaming test file size"
	default 1048576
	range 1048576 1048576
	---help---
		The persistent flash and SD files are streamed through a 4 KiB Hub
		buffer.  One MiB is larger than the P2's entire 512 KiB Hub RAM, so a
		passing write/read CRC cannot have come from a whole-file RAM buffer.

config TESTING_P2STORAGE_DESTRUCTIVE
	bool "Enable explicitly authenticated destructive storage commands"
	default n
	depends on FSUTILS_MKSMARTFS && FSUTILS_MKFATFS
	---help---
		Compile handlers which format or write the flash and microSD media.
		Every destructive invocation must also carry the exact argument
		P2STORAGE-I-ACCEPT-DATA-LOSS-V1.  Keeping this option disabled
		removes the handlers; attempts then fail explicitly with ENOSYS.

config TESTING_P2STORAGE_FLASH_PREMOUNTED
	bool "Use an already-mounted flash filesystem for read-only verification"
	default n
	depends on !TESTING_P2STORAGE_DESTRUCTIVE
	---help---
		Do not mount or unmount the flash filesystem around flash-verify.
		This is for the flash-boot profile, whose ROMFS startup script has
		already mounted the exact /dev/smart0 device at the configured flash
		mountpoint.  The option does not change SD verification.

config TESTING_P2STORAGE_FLASH_CYCLE_COUNT
	int "Flash rewrite cycle count"
	default 16
	range 1 1000
	depends on TESTING_P2STORAGE_DESTRUCTIVE

config TESTING_P2STORAGE_SD_STRESS_COUNT
	int "microSD stress iteration count"
	default 64
	range 1 10000
	depends on TESTING_P2STORAGE_DESTRUCTIVE

config TESTING_P2STORAGE_BUS_ALTERNATE_COUNT
	int "Flash/microSD alternating iteration count"
	default 1000
	range 1000 10000
	depends on TESTING_P2STORAGE_DESTRUCTIVE

config TESTING_P2STORAGE_FLASH_FULL_MAX_BYTES
	int "Maximum bytes attempted by the flash-full test"
	default 20971520
	range 16777216 33554432
	depends on TESTING_P2STORAGE_DESTRUCTIVE
	---help---
		A safety bound beyond the 15.5-MiB protected data partition.  The
		flash-full command passes only after the filesystem reports ENOSPC;
		reaching this bound is a failure.

config TESTING_P2STORAGE_INTERRUPT_HOLD_MSEC
	int "Interrupted-write power-cut window in milliseconds"
	default 10000
	range 1000 60000
	depends on TESTING_P2STORAGE_DESTRUCTIVE
	---help---
		Time the flash-interrupt-arm command leaves its partial file open
		after emitting READY:POWER-CUT.  The HIL controller must reset the
		board in this window; a normal timeout is reported as a failure.

endif
```
