## examples/p2lvgl/Kconfig
```kconfig
#
# For a description of the syntax of this configuration file,
# see the file kconfig-language.txt in the NuttX tools repository.
#

menuconfig EXAMPLES_P2LVGL
	tristate "Small Propeller 2 LVGL display/touch demo"
	default n
	depends on GRAPHICS_LVGL && LV_USE_NUTTX && LV_USE_NUTTX_LCD
	depends on P2_EC32MB_ILI9341_XPT2046
	---help---
		Build a small LVGL screen for the P2 ILI9341/XPT2046 profile.  It
		contains three small pages for redraw performance, common widgets, and
		an on-screen keyboard; LVGL's large bundled demo suite is not required.
		The demo polls XPT2046 Z1 pressure directly because some modules do not
		assert their PEN output reliably.

if EXAMPLES_P2LVGL

config EXAMPLES_P2LVGL_PRIORITY
	int "p2lvgl task priority"
	default 100

config EXAMPLES_P2LVGL_STACKSIZE
	int "p2lvgl stack size"
	default 12288

config EXAMPLES_P2LVGL_RAW_X_LEFT
	int "Raw X at the left calibration target"
	default 297
	range 0 4095

config EXAMPLES_P2LVGL_RAW_X_RIGHT
	int "Raw X at the right calibration target"
	default 1764
	range 0 4095

config EXAMPLES_P2LVGL_RAW_Y_TOP
	int "Raw Y at the top calibration target"
	default 216
	range 0 4095

config EXAMPLES_P2LVGL_RAW_Y_BOTTOM
	int "Raw Y at the bottom calibration target"
	default 1812
	range 0 4095

config EXAMPLES_P2LVGL_CAL_MARGIN
	int "Calibration target margin in pixels"
	default 24
	range 1 80

config EXAMPLES_P2LVGL_PRESSURE_MIN
	int "Minimum XPT2046 Z1 pressure"
	default 100
	range 1 4094

endif
```

## examples/p2touchcal/Kconfig
```kconfig
#
# For a description of the syntax of this configuration file,
# see the file kconfig-language.txt in the NuttX tools repository.
#

menuconfig EXAMPLES_P2TOUCHCAL
	tristate "Propeller 2 framebuffer touch calibration"
	default n
	depends on VIDEO_FB && FB_UPDATE && INPUT_TOUCHSCREEN
	---help---
		Build a four-corner framebuffer calibration utility for the
		ILI9341/XPT2046 P2 profile.  It averages at least three raw samples
		per target and prints the orientation-preserving calibration result.

if EXAMPLES_P2TOUCHCAL

config EXAMPLES_P2TOUCHCAL_PRIORITY
	int "p2touchcal task priority"
	default 100

config EXAMPLES_P2TOUCHCAL_STACKSIZE
	int "p2touchcal stack size"
	default 4096

config EXAMPLES_P2TOUCHCAL_FB_DEVPATH
	string "Framebuffer device path"
	default "/dev/fb0"

config EXAMPLES_P2TOUCHCAL_INPUT_DEVPATH
	string "Raw touchscreen device path"
	default "/dev/input0"

endif
```

## interpreters/berry/Kconfig
```kconfig
#
# For a description of the syntax of this configuration file,
# see the file kconfig-language.txt in the NuttX tools repository.
#

config INTERPRETERS_BERRY
	tristate "Berry scripting language"
	default n
	depends on ARCH_SETJMP_H
	depends on LIBC_FLOATINGPOINT || ARCH_P2
	depends on !LIBM_NONE
	depends on SYSTEM_SYSTEM || ARCH_P2
	---help---
		Enable the Berry embedded scripting language as an NSH built-in
		command.  Berry provides a small ANSI C99 compiler, register-based
		virtual machine, garbage collector, file I/O, bytecode loading and
		saving, and built-in modules.

		The default NuttX configuration keeps Berry shared-library loading
		disabled so boards do not need CONFIG_LIBC_DLFCN.  The math module
		is enabled on normal targets, so select a NuttX math library or provide
		one from the toolchain.  The P2 size profile disables the optional math
		module and uses single precision, but Berry's VM still needs fmodf().
		P2 also disables Berry's OS module, so it does not require the
		SYSTEM_SYSTEM implementation merely to provide system().

if INTERPRETERS_BERRY

config INTERPRETERS_BERRY_PROGNAME
	string "Berry program name"
	default "berry"
	---help---
		The command name used to start the Berry interpreter.

config INTERPRETERS_BERRY_PRIORITY
	int "Berry interpreter priority"
	default 100
	---help---
		Task priority of the Berry interpreter main task.

config INTERPRETERS_BERRY_STACKSIZE
	int "Berry interpreter stack size"
	default 12288
	---help---
		Size of the stack allocated for the Berry interpreter main task.

endif # INTERPRETERS_BERRY
```

## interpreters/python/Kconfig
```kconfig
#
# For a description of the syntax of this configuration file,
# see the file kconfig-language.txt in the NuttX tools repository.
#

config INTERPRETERS_CPYTHON
	tristate "CPython"
	depends on LIB_ZLIB
	depends on !DISABLE_PTHREAD
	depends on !LIBC_DLFCN || LIB_LIBFFI
	depends on EXPERIMENTAL
	default n
	---help---
		Enable the CPython port to NuttX. This is a port of the Python
		interpreter to NuttX. Initially, it is tweaked to work with the
		RISC-V QEMU virtual board (`rv-virt`).

if INTERPRETERS_CPYTHON

config INTERPRETERS_CPYTHON_VERSION
	string "Python Version"
	default "3.13.0"

config INTERPRETERS_CPYTHON_STACKSIZE
	int "CPython stack size"
	default 307200
	---help---
		This is the stack size allocated for the CPython worker thread.  The
		command launcher has a separate, smaller stack so it can reject a
		concurrent interpreter before allocating this stack.

config INTERPRETERS_CPYTHON_LAUNCHER_STACKSIZE
	int "CPython command launcher stack size"
	default 2048
	range 1024 16384
	---help---
		This is the stack size allocated for the CPython command entry point.
		It only guards the process-global runtime, creates one worker, and
		waits for it.  The interpreter itself uses
		INTERPRETERS_CPYTHON_STACKSIZE.

config INTERPRETERS_CPYTHON_P2_OVERLAY_TELEMETRY
	bool "Report P2 CPython overlay progress"
	default n
	depends on ARCH_P2 && P2_HUB_OVERLAYS
	---help---
		Keep the small command task awake while its CPython worker runs and
		periodically report coherent resident overlay counters.  This does not
		enter overlay code and is safe while the worker owns the single Hub
		execution slot.  It is intended for target qualification and diagnosing
		an apparent interpreter stall.

config INTERPRETERS_CPYTHON_P2_OVERLAY_TELEMETRY_INTERVAL_MS
	int "P2 CPython overlay report interval (milliseconds)"
	default 60000
	range 1000 60000
	depends on INTERPRETERS_CPYTHON_P2_OVERLAY_TELEMETRY
	---help---
		Elapsed time between progress records while the CPython worker is live.
		The default emits the bounded eight-record P2PY:HOT snapshot about once a
		minute, plus one final snapshot when the worker exits.

config INTERPRETERS_CPYTHON_P2_DEFAULT_NO_SITE
	bool "Skip automatic CPython site initialization on P2"
	default n
	depends on ARCH_P2
	---help---
		Start CPython with PyConfig.site_import disabled on Propeller 2.  This
		sets sys.flags.no_site without rewriting the command-line arguments.
		The site module remains available for an explicit import followed by
		site.main().  This can reduce startup overlay traffic on small-Hub P2
		targets while preserving an opt-in path for normal site processing.

config INTERPRETERS_CPYTHON_P2_FIXED_PATH_CONFIG
	bool "Use the fixed NuttX CPython path layout on P2"
	default n
	depends on ARCH_P2
	---help---
		Populate PyConfig directly from the NuttX CPython filesystem contract
		instead of evaluating CPython's frozen getpath.py during startup.  The
		writable path comes from INTERPRETERS_CPYTHON_PYTHONPATH and the standard
		library archive must be mounted as
		/usr/local/lib/python<major><minor>.zip.  Leave this disabled for boards
		that do not provide that exact layout.

config INTERPRETERS_CPYTHON_PRIORITY
	int "CPython task priority"
	default 100
	---help---
		This is the priority of the CPython task.

config INTERPRETERS_CPYTHON_PROGNAME
	string "CPython name"
	default "python"
	---help---
		This is the name of the program that will be used from the nsh.

config INTERPRETERS_CPYTHON_ENABLE_PIP
	bool "Enable bundled pip"
	default n
	---help---
		Enable bundling pip into the CPython module image. When enabled, the
		build downloads the pip wheel and pre-installs it through a
		site-packages .pth entry that points to ensurepip's bundled wheel.
		Disable this to skip pip wheel download/integration entirely.

config INTERPRETERS_CPYTHON_INSTALL_NUTTX_PACKAGE
	bool "Install NuttX Python package"
	default y
	---help---
		Installs the nuttx-periphery Python package into the CPython module image.
		This allows importing the nuttx-periphery package into the CPython interpreter,
		which provides a Python interface to the NuttX's peripheral drivers.

config INTERPRETERS_CPYTHON_PYTHONPATH
	string "CPython Python path"
	default "/tmp"
	---help---
		This is the Python default search path for modules files. This is
		required to be a writable path.

config INTERPRETERS_CPYTHON_EXTERNAL_ROMFS
	bool "Provide the CPython ROMFS from board-managed memory"
	default n
	---help---
		Do not compile the standard-library ROMFS into the application archive.
		The board must validate and publish an immutable image through
		board_cpython_runtime_prepare() and board_cpython_romfs_image(), validate
		the writable runtime filesystem through board_cpython_tmpfs_validate(),
		then register the image through board_cpython_romdisk_register().  The
		registration hook must select buffered access when the returned pointer
		is not a true CPU-addressable XIP mapping.  This is intended for targets such as
		Propeller 2 where the module image lives in external unified memory.  The
		build still emits
		romfs_cpython_modules.img as a separately packaged artifact.

config INTERPRETERS_CPYTHON_ROMFS_SECTORSIZE
	int "CPython ROMFS block sector size"
	default 64
	range 16 4096
	---help---
		Sector size exposed by the CPython ROM disk.  External memories with a
		non-trivial transfer setup cost benefit from a larger sector, at the
		cost of one sector-sized filesystem cache allocation per open file.

endif
```

## system/p2bank/Kconfig
```kconfig
#
# For a description of the syntax of this configuration file,
# see the file kconfig-language.txt in the NuttX tools repository.
#

config SYSTEM_P2BANK
	bool "Propeller 2 PSRAM bank launcher"
	default n
	depends on ARCH_BOARD_P2_EC32MB
	depends on P2_EC32MB_PSRAM
	depends on BUILTIN && NSH_BUILTIN_APPS
	---help---
		Add the p2bank manager command and its berry convenience alias.  The
		launcher streams a bounded raw bank image from onboard flash into an
		explicit PSRAM staging window, verifies a readback CRC-32, and then asks
		the PSRAM service cog to replace Hub and warm-start the bank.  External
		PSRAM remains a block-transfer store, not native heap or code memory.

if SYSTEM_P2BANK

config SYSTEM_P2BANK_PRIORITY
	int "p2bank task priority"
	default 100

config SYSTEM_P2BANK_STACKSIZE
	int "p2bank task stack size"
	default 3072

config SYSTEM_P2BANK_BUFSIZE
	int "p2bank streaming buffer size"
	default 4096
	range 256 16384
	---help---
		Allocate this temporary Hub buffer only while staging and verifying a
		bank.  It is not a permanent BSS reservation.

config SYSTEM_P2BANK_DEFAULT_BANK
	string "Default Berry bank image"
	default "/mnt/flash/banks/berry.bin"

endif
```

## system/p2berrybank/Kconfig
```kconfig
#
# For a description of the syntax of this configuration file,
# see the file kconfig-language.txt in the NuttX tools repository.
#

config SYSTEM_P2BERRYBANK
	bool "Propeller 2 Berry/LVGL bank entrypoint"
	default n
	depends on ARCH_BOARD_P2_EC32MB
	depends on BOARDCTL && BOARDCTL_RESET && BOARD_LATE_INITIALIZE
	depends on INTERPRETERS_BERRY=y && INTERPRETERS_BERRY_LVGL
	depends on MMCSD_SPI && FS_FAT
	---help---
		Add the init entrypoint for the nonresident Berry/LVGL application
		bank.  It validates the fixed P2 bank handoff, mounts the existing SD
		FAT filesystem at /mnt/sd without formatting, runs the selected Berry
		requested script or an interactive REPL, then resets to the
		flash-resident manager.  The bank-only quit([status]) native exits the
		REPL without enabling Berry's larger OS module.

if SYSTEM_P2BERRYBANK

config SYSTEM_P2BERRYBANK_PROGNAME
	string "Program name"
	default "p2berrybank"

config SYSTEM_P2BERRYBANK_PRIORITY
	int "p2berrybank task priority"
	default 100

config SYSTEM_P2BERRYBANK_STACKSIZE
	int "p2berrybank task stack size"
	default 16384

config SYSTEM_P2BERRYBANK_DEFAULT_SCRIPT
	string "Invalid-handoff recovery script"
	default "/mnt/sd/berry-p2/lvgl_widgets.be"
	---help---
		Run this script only for direct or otherwise invalid-handoff recovery.
		A valid manager handoff with no script intentionally starts the Berry
		REPL.  If this recovery file is absent, p2berrybank also starts the REPL.

endif
```

## system/p2help/Kconfig
```kconfig
#
# For a description of the syntax of this configuration file,
# see the file kconfig-language.txt in the NuttX tools repository.
#

config SYSTEM_P2HELP
	tristate "Propeller 2 showcase help"
	default n
	depends on ARCH_P2 && BUILD_FLAT
	depends on BUILTIN && NSH_BUILTIN_APPS
	---help---
		Add a compact p2help command which identifies the exact P2 Edge board
		and lists the registered showcase devices, pin sharing, and useful NSH
		demo commands.

if SYSTEM_P2HELP

config SYSTEM_P2HELP_PROGNAME
	string "Program name"
	default "p2help"

endif
```

## system/p2recv/Kconfig
```kconfig
#
# For a description of the syntax of this configuration file,
# see the file kconfig-language.txt in the NuttX tools repository.
#

config SYSTEM_P2RECV
	tristate "Propeller 2 serial file receiver"
	default n
	depends on ARCH_P2 && BUILTIN && NSH_BUILTIN_APPS
	---help---
		Add the p2recv NSH command.  It receives a host-framed byte stream
		from standard input, verifies per-chunk and whole-file CRC-32 values,
		then renames a same-directory temporary file into place.  Destination
		paths are deliberately limited to mounted filesystems below /mnt/.

if SYSTEM_P2RECV

config SYSTEM_P2RECV_PROGNAME
	string "Program name"
	default "p2recv"

config SYSTEM_P2RECV_PRIORITY
	int "p2recv task priority"
	default 100

config SYSTEM_P2RECV_STACKSIZE
	int "p2recv task stack size"
	default 3072

config SYSTEM_P2RECV_MAXSIZE
	int "Maximum accepted file size"
	default 67108864
	range 1 2147483647
	---help---
		Reject larger files before creating a temporary file.  The receiver
		streams through a fixed 256-byte buffer, so this limit does not reserve
		RAM.  The default permits provisioning larger SD-backed modules while
		remaining within the protocol's 32-bit length field.

config SYSTEM_P2RECV_TIMEOUT_MS
	int "Per-read serial timeout (milliseconds)"
	default 10000
	range 100 600000
	---help---
		Maximum time to wait for progress while reading a frame header or
		payload.  A timeout removes the temporary file and leaves any existing
		destination untouched.

endif
```

## system/termcurses/Kconfig
```kconfig
#
# For a description of the syntax of this configuration file,
# see the file kconfig-language.txt in the NuttX tools repository.
#

if SERIAL || TELNET

config SYSTEM_TERMCURSES
	bool "Terminal Curses control support"
	default n
	---help---
		Terminal emulation library for curses support on TTY type consoles
		such as serial port, CDCACM, telnet, etc.

config SYSTEM_TERMCURSES_VT100
	bool "Terminal pdcurses support for VT-100"
	depends on SYSTEM_TERMCURSES
	default y

config SYSTEM_TERMCURSES_ESCDELAY_MS
	int "Escape sequence timeout (milliseconds)"
	depends on SYSTEM_TERMCURSES_VT100
	range 1 1000
	default 30
	---help---
		Maximum time to wait for bytes that follow ESC.  USB and network
		terminals may split one cursor-key sequence across several reads.

config SYSTEM_TERMCURSES_VT100_OSX_ALT_CODES
	bool "Support Mac OSX ALT keycodes in vt100 emulation."
	depends on SYSTEM_TERMCURSES_VT100
	default y

config SYSTEM_TERMCURSES_DEBUG_KEYCODES
	bool "Print raw terminal escape sequences for debug."
	depends on SYSTEM_TERMCURSES
	default n

config SYSTEM_TERMCURSES_INCLUDE_TERMINFO_NAME
	bool "Compile in static const 'terminfo' key names (for future use)."
	depends on SYSTEM_TERMCURSES
	default n

endif # SYSTEM_TERMCURSES
```
